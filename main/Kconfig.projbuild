## main/Kconfig.projbuild
```kconfig
menu "WiFi Configuration"

    config ESP_WIFI_SSID
        string "WiFi SSID"
        default "myssid"
        help
            SSID (network name) for the example to connect to.

    config ESP_WIFI_PASSWORD
        string "WiFi Password"
        default "mypassword"
        help
            WiFi password (WPA or WPA2) for the example to use.

    config ESP_MAXIMUM_RETRY
        int "Maximum retry"
        default 5
        help
            Set the Maximum retry to avoid station reconnecting to the AP unlimited when the AP is really inexistent.
endmenu

menu "i2c LCD Configuration"

    config I2C_MASTER_SCL
        int "I2C Master SCL GPIO number"
        range 0 34
        default 19
        help
            GPIO number (IOxx) for I2C SCL.
    
            Some GPIOs are used for other purposes (flash connections, etc.) and cannot be used.
    
            GPIOs 35-39 are input-only so cannot be used to drive the One Wire Bus.
    
    config I2C_MASTER_SDA
        int "I2C Master SDA GPIO number"
        range 0 34
        default 18
        help
            GPIO number (IOxx) for I2C SDA.
    
            Some GPIOs are used for other purposes (flash connections, etc.) and cannot be used.
    
            GPIOs 35-39 are input-only so cannot be used to drive the One Wire Bus.
    
    config LCD1602_I2C_ADDRESS
        hex "I2C Address for LCD1602 device"
        default 0x27
        help
            I2C address for HD44780-compatible LCD1602 device.
    
endmenu
    
menu "SNTP (Timezone) Configuration"

    choice SNTP_TIME_SYNC_METHOD
        prompt "Time synchronization method"
        default SNTP_TIME_SYNC_METHOD_IMMED
        help
            Time synchronization method.

        config SNTP_TIME_SYNC_METHOD_IMMED
            bool "update time immediately when received"
        config SNTP_TIME_SYNC_METHOD_SMOOTH
            bool "update time with smooth method (adjtime)"
        config SNTP_TIME_SYNC_METHOD_CUSTOM
            bool "custom implementation"
    endchoice

endmenu

menu "Qwiic Twist - Sparkfun"
    config QWIIC_TWIST_I2C_ADDRESS
        hex "I2C Address for Qwiic Twist device"
        default 0x3E
        help
            I2C address for Qwiic Twist device.
endmenu
```
